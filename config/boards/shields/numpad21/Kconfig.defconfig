## dts/bindings/behaviors/zmk,behavior-layer-cycle.yaml
```yaml
description: Chuyen lan luot cac layer trong danh sach

compatible: "zmk,behavior-layer-cycle"

include: zero_param.yaml

properties:
  cycle-layers:
    type: uint8-array
    required: true
```

## dts/bindings/behaviors/zmk,behavior-led-mode.yaml
```yaml
description: Chon che do hieu ung cho 6 day LED (GPIO)

compatible: "zmk,behavior-led-mode"

include: one_param.yaml

properties:
  leds-gpios:
    type: phandle-array
    required: true
```
